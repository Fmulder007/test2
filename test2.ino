#ifndef F_CPU
#define F_CPU 20000000UL
#endif

#include <Arduino.h>
#include <util/delay.h>
#include <EEPROM.h>
#include <stdint.h>
#include <stdbool.h>


// ============================================================================
// ATmega328P QFP32
//
// Тактирование:
//     F_CPU = 20 MHz
//
// Si5351A:
//     XTAL = 27 MHz
//
// Выходы:
//     CLK0 = F
//     CLK1 = F + 90°
//     CLK2 = OFF
//
// Энкодер:
//     PD6 = A
//     PD7 = B
//     внутренние pull-up
//
// LCD1602 + PCF8574:
//     SDA = PD2
//     SCL = PD3
//
// Кнопки диапазонов:
//     ADC3 = PC3 = физическая ножка 26
//
// EEPROM:
//     сохраняется частота каждого диапазона
//     запись выполняется только при переключении диапазона
// ============================================================================


// ============================================================================
// SI5351
// ============================================================================

#define SI5351_ADDR       0x60
#define SI5351_XTAL_HZ   27000000UL


// ============================================================================
// ОБЩИЙ ДИАПАЗОН SI5351
//
// Эти пределы используются генератором частоты PLL.
//
// Рабочие диапазоны энкодера задаются отдельно ниже.
// ============================================================================

#define PLL_MIN_HZ       400000000UL
#define PLL_MAX_HZ       750000000UL

#define PLL_A_MIN        15UL
#define PLL_A_MAX        90UL


// ============================================================================
// РАБОЧИЕ ДИАПАЗОНЫ
// ============================================================================
//
// BAND 0 = 80M
// BAND 1 = 40M
// BAND 2 = 20M
// ============================================================================

#define BAND_COUNT 3


#define BAND80_MIN_HZ   3500000UL
#define BAND80_MAX_HZ   3800000UL

#define BAND40_MIN_HZ   7000000UL
#define BAND40_MAX_HZ   7200000UL

#define BAND20_MIN_HZ   14000000UL
#define BAND20_MAX_HZ   14350000UL


#define STEP_FREQ_HZ    1000UL


// ============================================================================
// СТАРТОВАЯ ЧАСТОТА
//
// Используется только если в EEPROM ещё нет сохранённых данных.
//
// Стартовый диапазон:
//     40M
//
// Стартовая частота:
//     7100 kHz
// ============================================================================

#define DEFAULT_BAND       1
#define DEFAULT_FREQ_HZ    7100000UL


// ============================================================================
// ENCODER
//
// ATmega328P QFP32:
//
// PD6 = физическая ножка 12
// PD7 = физическая ножка 13
//
// Внутренние pull-up включаются через PORTD.
//
// Энкодер:
//
// A   -> PD6
// B   -> PD7
// COM -> GND
// ============================================================================

#define ENC_A       PD6
#define ENC_B       PD7

#define ENC_A_MASK  (1 << ENC_A)
#define ENC_B_MASK  (1 << ENC_B)


// ============================================================================
// ADC КНОПОК
//
// ATmega328P QFP32:
//
// PC3 = ADC3 = физическая ножка 26
//
// Здесь используется резистивная лестница кнопок.
//
// Поэтому внутреннюю pull-up на PC3 НЕ включаем.
// ============================================================================

#define BUTTON_ADC_CHANNEL  3


// ============================================================================
// ЗНАЧЕНИЯ ADC КНОПОК
// ============================================================================

#define BUTTON_NONE_VALUE  1023
#define BUTTON_A_VALUE      776
#define BUTTON_B_VALUE      941

#define BUTTON_ADC_TOLERANCE 50


// ============================================================================
// МИНИМАЛЬНАЯ ДЛИТЕЛЬНОСТЬ НАЖАТИЯ
// ============================================================================
//
// Кнопка должна непрерывно удерживаться не менее 100 мс.
//
// Это одновременно защищает от дребезга.
// ============================================================================

#define BUTTON_HOLD_TIME_MS 100UL


// ============================================================================
// ADC DISPLAY
//
// Значение ADC на второй строке LCD обновляется каждые 100 мс.
// ============================================================================

#define ADC_DISPLAY_PERIOD_MS 100UL


// ============================================================================
// LCD1602 + PCF8574
//
// SDA = PD2
// SCL = PD3
//
// PCF8574:
//     P0 = RS
//     P1 = RW
//     P2 = EN
//     P3 = Backlight
//     P4...P7 = D4...D7
// ============================================================================

#define LCD_ADDR 0x27

#define LCD_SDA PD2
#define LCD_SCL PD3

#define LCD_SDA_MASK (1 << LCD_SDA)
#define LCD_SCL_MASK (1 << LCD_SCL)


// ============================================================================
// EEPROM
// ============================================================================
//
// В EEPROM сохраняются:
//
//     частота 80M
//     частота 40M
//     частота 20M
//     выбранный диапазон
//
// Запись выполняется только при переходе на другой диапазон.
// ============================================================================

#define EEPROM_MAGIC 0x5353

struct EEPROMData
{
    uint16_t magic;

    uint8_t band;

    uint32_t freq80;
    uint32_t freq40;
    uint32_t freq20;
};


// ============================================================================
// BAND
// ============================================================================

struct BandInfo
{
    const char *name;

    uint32_t minHz;
    uint32_t maxHz;
};


// ============================================================================
// ТАБЛИЦА ДИАПАЗОНОВ
// ============================================================================

const BandInfo bands[BAND_COUNT] =
{
    {
        "80M",
        BAND80_MIN_HZ,
        BAND80_MAX_HZ
    },

    {
        "40M",
        BAND40_MIN_HZ,
        BAND40_MAX_HZ
    },

    {
        "20M",
        BAND20_MIN_HZ,
        BAND20_MAX_HZ
    }
};


// ============================================================================
// ТЕКУЩИЙ ДИАПАЗОН
// ============================================================================

uint8_t currentBand = DEFAULT_BAND;


// ============================================================================
// ЧАСТОТЫ ДИАПАЗОНОВ
//
// Каждая частота хранится отдельно.
// ============================================================================

uint32_t bandFrequency[BAND_COUNT] =
{
    BAND80_MIN_HZ,
    DEFAULT_FREQ_HZ,
    BAND20_MIN_HZ
};


// ============================================================================
// ТЕКУЩАЯ ЧАСТОТА
// ============================================================================

uint32_t currentFreqHz = DEFAULT_FREQ_HZ;


// ============================================================================
// ENCODER STATE
// ============================================================================

uint8_t encoderPreviousState = 0;

int8_t encoderAccumulator = 0;


// ============================================================================
// BUTTON STATE
// ============================================================================

enum ButtonState
{
    BUTTON_NONE,
    BUTTON_A,
    BUTTON_B
};


ButtonState buttonCandidate = BUTTON_NONE;

ButtonState buttonActive = BUTTON_NONE;

uint32_t buttonStartTime = 0;


// ============================================================================
// ADC DISPLAY TIMER
// ============================================================================

uint32_t lastADCDisplayTime = 0;


// ============================================================================
// SI5351 FREQUENCY PLAN
// ============================================================================

struct FrequencyPlan
{
    uint16_t ms;

    uint32_t pllHz;

    uint32_t pllA;
    uint32_t pllB;
    uint32_t pllC;

    uint8_t phase;
};


// ============================================================================
// I2C DELAY
// ============================================================================

static inline void i2cDelay()
{
    _delay_us(1);
}


// ============================================================================
// SI5351 SDA LOW
// ============================================================================

static inline void siSdaLow()
{
    PORTC &= ~(1 << PC4);
    DDRC |= (1 << PC4);
}


// ============================================================================
// SI5351 SDA RELEASE
// ============================================================================

static inline void siSdaRelease()
{
    DDRC &= ~(1 << PC4);
    PORTC |= (1 << PC4);
}


// ============================================================================
// SI5351 SCL LOW
// ============================================================================

static inline void siSclLow()
{
    PORTC &= ~(1 << PC5);
    DDRC |= (1 << PC5);
}


// ============================================================================
// SI5351 SCL RELEASE
// ============================================================================

static inline void siSclRelease()
{
    DDRC &= ~(1 << PC5);
    PORTC |= (1 << PC5);
}


// ============================================================================
// SI5351 I2C INIT
// ============================================================================

void siI2CInit()
{
    siSdaRelease();
    siSclRelease();

    _delay_ms(5);
}


// ============================================================================
// SI5351 I2C START
// ============================================================================

void siStart()
{
    siSdaRelease();
    siSclRelease();

    i2cDelay();

    siSdaLow();

    i2cDelay();

    siSclLow();

    i2cDelay();
}


// ============================================================================
// SI5351 I2C STOP
// ============================================================================

void siStop()
{
    siSdaLow();

    i2cDelay();

    siSclRelease();

    i2cDelay();

    siSdaRelease();

    i2cDelay();
}


// ============================================================================
// SI5351 WRITE BYTE
// ============================================================================

bool siWriteByte(uint8_t data)
{
    for (uint8_t i = 0; i < 8; i++)
    {
        if (data & 0x80)
            siSdaRelease();
        else
            siSdaLow();

        i2cDelay();

        siSclRelease();

        i2cDelay();

        siSclLow();

        i2cDelay();

        data <<= 1;
    }


    // ------------------------------------------------------------------------
    // ACK
    // ------------------------------------------------------------------------

    siSdaRelease();

    i2cDelay();

    siSclRelease();

    i2cDelay();

    bool ack =
        !(PINC & (1 << PC4));

    siSclLow();

    i2cDelay();

    return ack;
}


// ============================================================================
// WRITE SI5351 REGISTER
// ============================================================================

bool siWriteRegister(
    uint8_t reg,
    uint8_t value
)
{
    siStart();


    if (!siWriteByte(
        SI5351_ADDR << 1
    ))
    {
        siStop();
        return false;
    }


    if (!siWriteByte(reg))
    {
        siStop();
        return false;
    }


    if (!siWriteByte(value))
    {
        siStop();
        return false;
    }


    siStop();

    return true;
}


// ============================================================================
// WRITE SI5351 BLOCK
// ============================================================================

bool siWriteBlock(
    uint8_t reg,
    const uint8_t *data,
    uint8_t length
)
{
    siStart();


    if (!siWriteByte(
        SI5351_ADDR << 1
    ))
    {
        siStop();
        return false;
    }


    if (!siWriteByte(reg))
    {
        siStop();
        return false;
    }


    for (uint8_t i = 0; i < length; i++)
    {
        if (!siWriteByte(data[i]))
        {
            siStop();
            return false;
        }
    }


    siStop();

    return true;
}


// ============================================================================
// CALCULATE P1/P2/P3
// ============================================================================

void calculateParams(
    uint32_t a,
    uint32_t b,
    uint32_t c,
    uint32_t *p1,
    uint32_t *p2,
    uint32_t *p3
)
{
    uint32_t x =
        (128UL * b) / c;


    *p1 =
        128UL * a +
        x -
        512UL;


    *p2 =
        128UL * b -
        c * x;


    *p3 =
        c;
}


// ============================================================================
// CALCULATE FREQUENCY PLAN
// ============================================================================
//
// Для сохранения квадратурного сдвига:
//
//     MS = 4, 8, 12, 16, ...
//
// Фазовый регистр CLK1:
//
//     phase = MS / 4
//
// При одинаковом PLL и одинаковом integer MultiSynth
// это обеспечивает сдвиг CLK1 относительно CLK0 на 90°.
//
// Ограничение phase register:
//
//     0...127
//
// Поэтому:
//
//     MS <= 508
// ============================================================================

bool calculateFrequencyPlan(
    uint32_t frequencyHz,
    FrequencyPlan *plan
)
{
    uint64_t bestError =
        0xFFFFFFFFFFFFFFFFULL;

    bool found = false;

    FrequencyPlan best;


    for (
        uint16_t ms = 4;
        ms <= 508;
        ms += 4
    )
    {
        uint64_t targetPLL64 =
            (uint64_t)frequencyHz * ms;


        if (targetPLL64 < PLL_MIN_HZ)
            continue;


        if (targetPLL64 > PLL_MAX_HZ)
            continue;


        uint32_t targetPLL =
            (uint32_t)targetPLL64;


        // --------------------------------------------------------------------
        // PLL = XTAL × (a + b/c)
        // --------------------------------------------------------------------

        uint32_t a =
            targetPLL /
            SI5351_XTAL_HZ;


        if (
            a < PLL_A_MIN ||
            a > PLL_A_MAX
        )
        {
            continue;
        }


        uint32_t remainder =
            targetPLL %
            SI5351_XTAL_HZ;


        // --------------------------------------------------------------------
        // Максимальный допустимый знаменатель PLL.
        // --------------------------------------------------------------------

        uint32_t c =
            1048575UL;


        uint32_t b =
            (uint32_t)
            (
                (
                    (uint64_t)remainder *
                    c +
                    SI5351_XTAL_HZ / 2
                )
                /
                SI5351_XTAL_HZ
            );


        if (b >= c)
        {
            a++;
            b = 0;
        }


        // --------------------------------------------------------------------
        // Сокращение дроби B/C.
        // --------------------------------------------------------------------

        if (b != 0)
        {
            uint32_t x = b;
            uint32_t y = c;


            while (y != 0)
            {
                uint32_t t =
                    x % y;

                x = y;
                y = t;
            }


            b /= x;
            c /= x;
        }
        else
        {
            c = 1;
        }


        // --------------------------------------------------------------------
        // Реальная частота PLL.
        // --------------------------------------------------------------------

        uint64_t numerator =
            (uint64_t)SI5351_XTAL_HZ *
            (
                (uint64_t)a * c +
                b
            );


        uint32_t realPLL =
            (uint32_t)
            (
                (
                    numerator +
                    c / 2
                )
                /
                c
            );


        // --------------------------------------------------------------------
        // Ошибка.
        // --------------------------------------------------------------------

        uint64_t error =
            (
                realPLL > targetPLL
            )
            ?
            (uint64_t)(realPLL - targetPLL)
            :
            (uint64_t)(targetPLL - realPLL);


        // --------------------------------------------------------------------
        // Сохраняем лучший вариант.
        // --------------------------------------------------------------------

        if (
            !found ||
            error < bestError
        )
        {
            found = true;

            bestError = error;


            best.ms =
                ms;


            best.pllHz =
                realPLL;


            best.pllA =
                a;


            best.pllB =
                b;


            best.pllC =
                c;


            // 90° относительно CLK0.

            best.phase =
                ms / 4;
        }
    }


    if (!found)
        return false;


    *plan = best;

    return true;
}


// ============================================================================
// WRITE PLLA
//
// Registers 26...33
// ============================================================================

bool writePLLA(
    const FrequencyPlan &plan
)
{
    uint32_t p1;
    uint32_t p2;
    uint32_t p3;


    calculateParams(
        plan.pllA,
        plan.pllB,
        plan.pllC,
        &p1,
        &p2,
        &p3
    );


    uint8_t d[8];


    d[0] =
        (p3 >> 8) & 0xFF;


    d[1] =
        p3 & 0xFF;


    d[2] =
        (p1 >> 16) & 0x03;


    d[3] =
        (p1 >> 8) & 0xFF;


    d[4] =
        p1 & 0xFF;


    d[5] =
        ((p3 >> 12) & 0xF0) |
        ((p2 >> 16) & 0x0F);


    d[6] =
        (p2 >> 8) & 0xFF;


    d[7] =
        p2 & 0xFF;


    return siWriteBlock(
        26,
        d,
        8
    );
}


// ============================================================================
// WRITE MULTISYNTH
//
// CLK0:
//     registers 42...49
//
// CLK1:
//     registers 50...57
// ============================================================================

bool writeMultiSynth(
    uint8_t baseReg,
    uint16_t ms
)
{
    uint32_t p1;
    uint32_t p2;
    uint32_t p3;


    calculateParams(
        ms,
        0,
        1,
        &p1,
        &p2,
        &p3
    );


    uint8_t d[8];


    d[0] =
        (p3 >> 8) & 0xFF;


    d[1] =
        p3 & 0xFF;


    d[2] =
        (p1 >> 16) & 0x03;


    d[3] =
        (p1 >> 8) & 0xFF;


    d[4] =
        p1 & 0xFF;


    d[5] = 0;
    d[6] = 0;
    d[7] = 0;


    return siWriteBlock(
        baseReg,
        d,
        8
    );
}


// ============================================================================
// CONFIGURE CLK0
//
// PLLA
// Integer MultiSynth
// 8 mA
// Phase = 0
// ============================================================================

bool configureCLK0()
{
    return siWriteRegister(
        16,
        0x4F
    );
}


// ============================================================================
// CONFIGURE CLK1
//
// PLLA
// Integer MultiSynth
// 8 mA
// Фазовый сдвиг задаётся отдельно регистром 166.
// ============================================================================

bool configureCLK1()
{
    return siWriteRegister(
        17,
        0x4F
    );
}


// ============================================================================
// DISABLE CLK2
// ============================================================================

bool disableCLK2()
{
    return siWriteRegister(
        18,
        0x80 | 0x0F
    );
}


// ============================================================================
// SET QUADRATURE PHASE
//
// CLK0 = 0°
//
// CLK1 = phase
//
// phase = MS / 4
//
// При одинаковом integer MultiSynth это соответствует 90°.
// ============================================================================

bool setQuadraturePhase(
    uint8_t phase
)
{
    // ------------------------------------------------------------------------
    // CLK0 = 0°
    // Register 165
    // ------------------------------------------------------------------------

    if (!siWriteRegister(
        165,
        0
    ))
    {
        return false;
    }


    // ------------------------------------------------------------------------
    // CLK1 = +90°
    // Register 166
    // ------------------------------------------------------------------------

    if (!siWriteRegister(
        166,
        phase
    ))
    {
        return false;
    }


    return true;
}


// ============================================================================
// RESET PLLA
// ============================================================================

bool resetPLLA()
{
    bool ok =
        siWriteRegister(
            177,
            0x20
        );


    _delay_ms(1);

    return ok;
}


// ============================================================================
// OUTPUT CONTROL
//
// Register 3:
//
// bit 0 = CLK0 disable
// bit 1 = CLK1 disable
// bit 2 = CLK2 disable
//
// CLK0 ON
// CLK1 ON
// CLK2 OFF
//
// 11111100 = 0xFC
// ============================================================================

bool enableOutputs()
{
    return siWriteRegister(
        3,
        0xFC
    );
}


// ============================================================================
// APPLY FREQUENCY
//
// Перестраивает PLLA и оба MultiSynth.
//
// CLK0 и CLK1 используют один и тот же PLL и один и тот же
// целочисленный MultiSynth.
//
// Фазовый регистр CLK1 пересчитывается для каждого нового MS,
// поэтому фазовый сдвиг сохраняется при изменении частоты.
// ============================================================================

bool applyFrequency(
    uint32_t frequencyHz
)
{
    FrequencyPlan plan;


    if (!calculateFrequencyPlan(
        frequencyHz,
        &plan
    ))
    {
        return false;
    }


    // ------------------------------------------------------------------------
    // Временно выключаем все выходы.
    // ------------------------------------------------------------------------

    if (!siWriteRegister(
        3,
        0xFF
    ))
    {
        return false;
    }


    // ------------------------------------------------------------------------
    // PLLA
    // ------------------------------------------------------------------------

    if (!writePLLA(plan))
        return false;


    // ------------------------------------------------------------------------
    // CLK0 MultiSynth
    // ------------------------------------------------------------------------

    if (!writeMultiSynth(
        42,
        plan.ms
    ))
    {
        return false;
    }


    // ------------------------------------------------------------------------
    // CLK1 MultiSynth
    // ------------------------------------------------------------------------

    if (!writeMultiSynth(
        50,
        plan.ms
    ))
    {
        return false;
    }


    // ------------------------------------------------------------------------
    // CLK0
    // ------------------------------------------------------------------------

    if (!configureCLK0())
        return false;


    // ------------------------------------------------------------------------
    // CLK1
    // ------------------------------------------------------------------------

    if (!configureCLK1())
        return false;


    // ------------------------------------------------------------------------
    // CLK2 OFF
    // ------------------------------------------------------------------------

    if (!disableCLK2())
        return false;


    // ------------------------------------------------------------------------
    // Фаза CLK0/CLK1
    // ------------------------------------------------------------------------

    if (!setQuadraturePhase(
        plan.phase
    ))
    {
        return false;
    }


    // ------------------------------------------------------------------------
    // Сброс PLLA после изменения параметров.
    // ------------------------------------------------------------------------

    if (!resetPLLA())
        return false;


    // ------------------------------------------------------------------------
    // CLK0 + CLK1 ON
    // CLK2 OFF
    // ------------------------------------------------------------------------

    if (!enableOutputs())
        return false;


    return true;
}


// ============================================================================
// LCD SOFTWARE I2C
// ============================================================================

void lcdSdaLow()
{
    PORTD &= ~LCD_SDA_MASK;
    DDRD |= LCD_SDA_MASK;
}


void lcdSdaHigh()
{
    DDRD &= ~LCD_SDA_MASK;
    PORTD |= LCD_SDA_MASK;
}


void lcdSclLow()
{
    PORTD &= ~LCD_SCL_MASK;
    DDRD |= LCD_SCL_MASK;
}


void lcdSclHigh()
{
    DDRD &= ~LCD_SCL_MASK;
    PORTD |= LCD_SCL_MASK;
}


void lcdDelay()
{
    _delay_us(5);
}


// ============================================================================
// LCD START
// ============================================================================

void lcdStart()
{
    lcdSdaHigh();
    lcdSclHigh();

    lcdDelay();

    lcdSdaLow();

    lcdDelay();

    lcdSclLow();

    lcdDelay();
}


// ============================================================================
// LCD STOP
// ============================================================================

void lcdStop()
{
    lcdSdaLow();

    lcdDelay();

    lcdSclHigh();

    lcdDelay();

    lcdSdaHigh();

    lcdDelay();
}


// ============================================================================
// LCD WRITE BYTE
// ============================================================================

void lcdWriteI2CByte(
    uint8_t data
)
{
    for (uint8_t i = 0; i < 8; i++)
    {
        if (data & 0x80)
            lcdSdaHigh();
        else
            lcdSdaLow();


        lcdDelay();

        lcdSclHigh();

        lcdDelay();

        lcdSclLow();

        lcdDelay();

        data <<= 1;
    }


    // ------------------------------------------------------------------------
    // ACK.
    //
    // Для LCD он не используется.
    // ------------------------------------------------------------------------

    lcdSdaHigh();

    lcdDelay();

    lcdSclHigh();

    lcdDelay();

    lcdSclLow();

    lcdDelay();
}


// ============================================================================
// LCD PCF8574 WRITE
// ============================================================================

void lcdPCFWrite(
    uint8_t data
)
{
    lcdStart();

    lcdWriteI2CByte(
        LCD_ADDR << 1
    );

    lcdWriteI2CByte(
        data
    );

    lcdStop();
}


// ============================================================================
// LCD SEND NIBBLE
// ============================================================================

void lcdSendNibble(
    uint8_t nibble,
    bool rs
)
{
    uint8_t data =
        (nibble & 0x0F) << 4;


    if (rs)
        data |= 0x01;


    // Backlight ON

    data |= 0x08;


    // EN = 1

    lcdPCFWrite(
        data | 0x04
    );


    // EN = 0

    lcdPCFWrite(
        data
    );
}


// ============================================================================
// LCD SEND BYTE
// ============================================================================

void lcdSendByte(
    uint8_t value,
    bool rs
)
{
    lcdSendNibble(
        value >> 4,
        rs
    );


    lcdSendNibble(
        value & 0x0F,
        rs
    );
}


// ============================================================================
// LCD COMMAND
// ============================================================================

void lcdCommand(
    uint8_t command
)
{
    lcdSendByte(
        command,
        false
    );


    if (
        command == 0x01 ||
        command == 0x02
    )
    {
        _delay_ms(2);
    }
}


// ============================================================================
// LCD DATA
// ============================================================================

void lcdData(
    uint8_t data
)
{
    lcdSendByte(
        data,
        true
    );
}


// ============================================================================
// LCD INIT
// ============================================================================

void lcdInit()
{
    // ------------------------------------------------------------------------
    // SDA/SCL в режиме входа с HIGH.
    // ------------------------------------------------------------------------

    DDRD &= ~(
        LCD_SDA_MASK |
        LCD_SCL_MASK
    );


    PORTD |=
        LCD_SDA_MASK |
        LCD_SCL_MASK;


    _delay_ms(50);


    // ------------------------------------------------------------------------
    // Переход LCD в 4-битный режим.
    // ------------------------------------------------------------------------

    lcdSendNibble(
        0x03,
        false
    );

    _delay_ms(5);


    lcdSendNibble(
        0x03,
        false
    );

    _delay_us(150);


    lcdSendNibble(
        0x03,
        false
    );

    _delay_us(150);


    lcdSendNibble(
        0x02,
        false
    );

    _delay_us(150);


    // 4-bit / 2-line / 5x8

    lcdCommand(0x28);


    // Display OFF

    lcdCommand(0x08);


    // Clear

    lcdCommand(0x01);


    // Entry mode

    lcdCommand(0x06);


    // Display ON

    lcdCommand(0x0C);
}


// ============================================================================
// LCD SET CURSOR
// ============================================================================

void lcdSetCursor(
    uint8_t column,
    uint8_t row
)
{
    uint8_t address;


    if (row == 0)
        address = column;
    else
        address = 0x40 + column;


    lcdCommand(
        0x80 | address
    );
}


// ============================================================================
// LCD PRINT
// ============================================================================

void lcdPrint(
    const char *text
)
{
    while (*text)
    {
        lcdData(
            *text++
        );
    }
}


// ============================================================================
// LCD DISPLAY FREQUENCY
//
// Первая строка:
//
//     40M   7100kHz
//
// Диапазон слева.
// Частота выравнивается по правому краю.
// ============================================================================

void displayFrequency()
{
    char line[17];


    // ------------------------------------------------------------------------
    // Полностью формируем 16 символов строки.
    // ------------------------------------------------------------------------

    for (uint8_t i = 0; i < 16; i++)
        line[i] = ' ';


    line[16] = '\0';


    // ------------------------------------------------------------------------
    // Название диапазона.
    // ------------------------------------------------------------------------

    line[0] =
        bands[currentBand].name[0];

    line[1] =
        bands[currentBand].name[1];

    line[2] =
        bands[currentBand].name[2];


    // ------------------------------------------------------------------------
    // Частота в kHz.
    //
    // Формат:
    //
    //     xxxxkHz
    //
    // Для 7100 kHz это 8 символов.
    // ------------------------------------------------------------------------

    uint32_t khz =
        currentFreqHz / 1000UL;


    char freq[9];

    uint8_t p = 0;


    if (khz >= 10000UL)
    {
        freq[p++] =
            '0' + ((khz / 10000UL) % 10);
    }


    freq[p++] =
        '0' + ((khz / 1000UL) % 10);


    freq[p++] =
        '0' + ((khz / 100UL) % 10);


    freq[p++] =
        '0' + ((khz / 10UL) % 10);


    freq[p++] =
        '0' + (khz % 10);


    freq[p++] = 'k';
    freq[p++] = 'H';
    freq[p++] = 'z';

    freq[p] = '\0';


    // ------------------------------------------------------------------------
    // Выравнивание частоты по правому краю.
    // ------------------------------------------------------------------------

    uint8_t freqLength = p;


    uint8_t start =
        16 - freqLength;


    for (uint8_t i = 0; i < freqLength; i++)
    {
        line[start + i] =
            freq[i];
    }


    // ------------------------------------------------------------------------
    // Вывод строки.
    // ------------------------------------------------------------------------

    lcdSetCursor(
        0,
        0
    );


    lcdPrint(line);
}


// ============================================================================
// LCD DISPLAY ADC
//
// Вторая строка:
//
//     ADC: 123
//
// Значение обновляется каждые 100 мс.
// ============================================================================

void displayADC(
    uint16_t value
)
{
    char line[17];


    for (uint8_t i = 0; i < 16; i++)
        line[i] = ' ';


    line[16] = '\0';


    line[0] = 'A';
    line[1] = 'D';
    line[2] = 'C';
    line[3] = ':';
    line[4] = ' ';


    uint16_t n = value;


    char digits[5];

    uint8_t count = 0;


    if (n == 0)
    {
        digits[count++] = '0';
    }
    else
    {
        while (n > 0)
        {
            digits[count++] =
                '0' + (n % 10);

            n /= 10;
        }
    }


    for (uint8_t i = 0; i < count; i++)
    {
        line[5 + i] =
            digits[count - 1 - i];
    }


    lcdSetCursor(
        0,
        1
    );


    lcdPrint(line);
}


// ============================================================================
// ADC INIT
//
// ADC3 = PC3 = физическая ножка 26.
//
// AVcc используется как опорное напряжение.
//
// Делитель ADC = 128.
//
// При F_CPU = 20 MHz:
//
//     ADC clock = 156.25 kHz
// ============================================================================

void adcInit()
{
    // ------------------------------------------------------------------------
    // ADC3 как вход.
    //
    // Pull-up НЕ включаем.
    // ------------------------------------------------------------------------

    DDRC &=
        ~(1 << PC3);

    PORTC &=
        ~(1 << PC3);


    // ------------------------------------------------------------------------
    // AVcc reference, ADC3.
    // ------------------------------------------------------------------------

    ADMUX =
        (1 << REFS0) |
        BUTTON_ADC_CHANNEL;


    // ------------------------------------------------------------------------
    // ADC enable.
    // Prescaler = 128.
    // ------------------------------------------------------------------------

    ADCSRA =
        (1 << ADEN) |
        (1 << ADPS2) |
        (1 << ADPS1) |
        (1 << ADPS0);


    // ------------------------------------------------------------------------
    // Первый запуск ADC.
    // ------------------------------------------------------------------------

    ADCSRA |=
        (1 << ADSC);


    while (
        ADCSRA &
        (1 << ADSC)
    )
    {
    }
}


// ============================================================================
// READ ADC3
// ============================================================================

uint16_t readADC()
{
    // ADC3.

    ADMUX =
        (1 << REFS0) |
        BUTTON_ADC_CHANNEL;


    ADCSRA |=
        (1 << ADSC);


    while (
        ADCSRA &
        (1 << ADSC)
    )
    {
    }


    return ADC;
}


// ============================================================================
// ENCODER READ
//
// Таблица полного квадратурного декодирования.
//
// Один полный цикл:
//
//     00 -> 01 -> 11 -> 10 -> 00
//
// = 4 перехода.
//
// Поэтому 4 перехода дают один шаг частоты.
// ============================================================================

int8_t readEncoder()
{
    uint8_t state = 0;


    if (PIND & ENC_A_MASK)
        state |= 1;


    if (PIND & ENC_B_MASK)
        state |= 2;


    static const int8_t table[16] =
    {
         0, -1,  1,  0,
         1,  0,  0, -1,
        -1,  0,  0,  1,
         0,  1, -1,  0
    };


    uint8_t index =
        (encoderPreviousState << 2) |
        state;


    int8_t movement =
        table[index];


    encoderPreviousState =
        state;


    return movement;
}


// ============================================================================
// ENCODER INIT
//
// PD6/PD7 = входы.
//
// Внутренние pull-up включаются именно через PORTD.
// ============================================================================

void encoderInit()
{
    // ------------------------------------------------------------------------
    // PD6/PD7 = INPUT
    // ------------------------------------------------------------------------

    DDRD &=
        ~(
            ENC_A_MASK |
            ENC_B_MASK
        );


    // ------------------------------------------------------------------------
    // INTERNAL PULL-UP
    // ------------------------------------------------------------------------

    PORTD |=
        ENC_A_MASK |
        ENC_B_MASK;


    // ------------------------------------------------------------------------
    // Читаем начальное состояние.
    // ------------------------------------------------------------------------

    uint8_t state = 0;


    if (PIND & ENC_A_MASK)
        state |= 1;


    if (PIND & ENC_B_MASK)
        state |= 2;


    encoderPreviousState =
        state;


    encoderAccumulator =
        0;
}


// ============================================================================
// EEPROM LOAD
//
// Если EEPROM содержит корректные данные, восстанавливаются:
//
//     выбранный диапазон
//     частота 80M
//     частота 40M
//     частота 20M
//
// Если данных нет — используются значения по умолчанию.
// ============================================================================

void loadEEPROM()
{
    EEPROMData data;


    EEPROM.get(
        0,
        data
    );


    // ------------------------------------------------------------------------
    // Проверяем magic.
    // ------------------------------------------------------------------------

    if (data.magic != EEPROM_MAGIC)
    {
        bandFrequency[0] =
            BAND80_MIN_HZ;

        bandFrequency[1] =
            DEFAULT_FREQ_HZ;

        bandFrequency[2] =
            BAND20_MIN_HZ;


        currentBand =
            DEFAULT_BAND;


        currentFreqHz =
            bandFrequency[currentBand];


        return;
    }


    // ------------------------------------------------------------------------
    // Восстанавливаем частоты.
    // ------------------------------------------------------------------------

    bandFrequency[0] =
        data.freq80;

    bandFrequency[1] =
        data.freq40;

    bandFrequency[2] =
        data.freq20;


    // ------------------------------------------------------------------------
    // Проверяем каждую частоту.
    // ------------------------------------------------------------------------

    if (
        bandFrequency[0] < BAND80_MIN_HZ ||
        bandFrequency[0] > BAND80_MAX_HZ
    )
    {
        bandFrequency[0] =
            BAND80_MIN_HZ;
    }


    if (
        bandFrequency[1] < BAND40_MIN_HZ ||
        bandFrequency[1] > BAND40_MAX_HZ
    )
    {
        bandFrequency[1] =
            DEFAULT_FREQ_HZ;
    }


    if (
        bandFrequency[2] < BAND20_MIN_HZ ||
        bandFrequency[2] > BAND20_MAX_HZ
    )
    {
        bandFrequency[2] =
            BAND20_MIN_HZ;
    }


    // ------------------------------------------------------------------------
    // Проверяем номер диапазона.
    // ------------------------------------------------------------------------

    if (data.band >= BAND_COUNT)
    {
        currentBand =
            DEFAULT_BAND;
    }
    else
    {
        currentBand =
            data.band;
    }


    currentFreqHz =
        bandFrequency[currentBand];
}


// ============================================================================
// EEPROM SAVE
//
// Записывается состояние диапазонов.
//
// Эта функция вызывается ТОЛЬКО при переключении диапазона.
// ============================================================================

void saveEEPROM()
{
    EEPROMData data;


    data.magic =
        EEPROM_MAGIC;


    data.band =
        currentBand;


    data.freq80 =
        bandFrequency[0];


    data.freq40 =
        bandFrequency[1];


    data.freq20 =
        bandFrequency[2];


    EEPROM.put(
        0,
        data
    );
}


// ============================================================================
// GET CURRENT BAND FREQUENCY
// ============================================================================

uint32_t getBandFrequency(
    uint8_t band
)
{
    if (band >= BAND_COUNT)
        return DEFAULT_FREQ_HZ;


    return bandFrequency[band];
}


// ============================================================================
// SET CURRENT FREQUENCY
// ============================================================================
//
// Частота изменяется только внутри границ текущего диапазона.
//
// EEPROM здесь НЕ записывается.
// Это важно для уменьшения количества циклов записи EEPROM.
// ============================================================================

void setCurrentFrequency(
    uint32_t frequencyHz
)
{
    const BandInfo &band =
        bands[currentBand];


    if (
        frequencyHz < band.minHz
    )
    {
        frequencyHz =
            band.minHz;
    }


    if (
        frequencyHz > band.maxHz
    )
    {
        frequencyHz =
            band.maxHz;
    }


    if (
        applyFrequency(
            frequencyHz
        )
    )
    {
        currentFreqHz =
            frequencyHz;


        bandFrequency[currentBand] =
            frequencyHz;


        displayFrequency();
    }
}


// ============================================================================
// SWITCH BAND
//
// Сначала сохраняется частота текущего диапазона.
//
// Затем выбирается новый диапазон.
//
// Из EEPROM ничего дополнительно читать не нужно —
// все три частоты уже находятся в RAM.
//
// После переключения новая частота устанавливается в Si5351.
//
// После этого вся информация сохраняется в EEPROM одной записью.
// ============================================================================

void switchBand(
    uint8_t newBand
)
{
    if (newBand >= BAND_COUNT)
        return;


    if (newBand == currentBand)
        return;


    // ------------------------------------------------------------------------
    // Сохраняем последнюю частоту текущего диапазона в RAM.
    // ------------------------------------------------------------------------

    bandFrequency[currentBand] =
        currentFreqHz;


    // ------------------------------------------------------------------------
    // Переключаем диапазон.
    // ------------------------------------------------------------------------

    currentBand =
        newBand;


    // ------------------------------------------------------------------------
    // Восстанавливаем частоту нового диапазона.
    // ------------------------------------------------------------------------

    currentFreqHz =
        bandFrequency[currentBand];


    // ------------------------------------------------------------------------
    // Перестраиваем Si5351.
    // ------------------------------------------------------------------------

    if (!applyFrequency(
        currentFreqHz
    ))
    {
        return;
    }


    // ------------------------------------------------------------------------
    // Теперь сохраняем диапазон и все три частоты EEPROM.
    //
    // Это единственная запись EEPROM при обычной работе.
    // ------------------------------------------------------------------------

    saveEEPROM();


    // ------------------------------------------------------------------------
    // Обновляем дисплей.
    // ------------------------------------------------------------------------

    displayFrequency();
}


// ============================================================================
// NEXT BAND
//
// A = следующий диапазон:
//
//     80M -> 40M -> 20M -> 80M
// ============================================================================

void selectNextBand()
{
    uint8_t newBand =
        currentBand + 1;


    if (newBand >= BAND_COUNT)
        newBand = 0;


    switchBand(
        newBand
    );
}


// ============================================================================
// PREVIOUS BAND
//
// B = предыдущий диапазон:
//
//     80M -> 20M -> 40M -> 80M
// ============================================================================

void selectPreviousBand()
{
    uint8_t newBand;


    if (currentBand == 0)
        newBand = BAND_COUNT - 1;
    else
        newBand = currentBand - 1;


    switchBand(
        newBand
    );
}


// ============================================================================
// READ BUTTON
//
// Возвращает:
//
//     BUTTON_NONE
//     BUTTON_A
//     BUTTON_B
//
// Значения имеют допуск ±50.
// ============================================================================

ButtonState readButton()
{
    uint16_t adc =
        readADC();


    // ------------------------------------------------------------------------
    // Кнопка A
    // ------------------------------------------------------------------------

    if (
        adc >=
        BUTTON_A_VALUE -
        BUTTON_ADC_TOLERANCE
        &&
        adc <=
        BUTTON_A_VALUE +
        BUTTON_ADC_TOLERANCE
    )
    {
        return BUTTON_A;
    }


    // ------------------------------------------------------------------------
    // Кнопка B
    // ------------------------------------------------------------------------

    if (
        adc >=
        BUTTON_B_VALUE -
        BUTTON_ADC_TOLERANCE
        &&
        adc <=
        BUTTON_B_VALUE +
        BUTTON_ADC_TOLERANCE
    )
    {
        return BUTTON_B;
    }


    // ------------------------------------------------------------------------
    // Остальное считаем отсутствием нажатия.
    //
    // В том числе нормальное значение около 1023.
    // ------------------------------------------------------------------------

    return BUTTON_NONE;
}


// ============================================================================
// BUTTON TASK
//
// Логика:
//
// 1. Обнаружили кнопку.
// 2. Запоминаем время начала.
// 3. Ждём непрерывные 100 мс.
// 4. Если кнопка всё ещё нажата — выполняем действие.
// 5. Пока кнопку держат, повторного действия нет.
// 6. После отпускания состояние сбрасывается.
//
// Таким образом:
//
//     короткое нажатие < 100 мс -> игнорируется
//
//     нажатие >= 100 мс -> одно переключение
// ============================================================================

void buttonTask()
{
    ButtonState currentButton =
        readButton();


    // ------------------------------------------------------------------------
    // Кнопка отпущена.
    // ------------------------------------------------------------------------

    if (
        currentButton ==
        BUTTON_NONE
    )
    {
        buttonCandidate =
            BUTTON_NONE;


        buttonActive =
            BUTTON_NONE;


        buttonStartTime =
            0;


        return;
    }


    // ------------------------------------------------------------------------
    // Обнаружено новое нажатие.
    // ------------------------------------------------------------------------

    if (
        currentButton !=
        buttonCandidate
    )
    {
        buttonCandidate =
            currentButton;


        buttonStartTime =
            millis();


        return;
    }


    // ------------------------------------------------------------------------
    // Кнопка удерживается.
    //
    // Проверяем, прошло ли 100 мс.
    // ------------------------------------------------------------------------

    if (
        buttonActive ==
        BUTTON_NONE
    )
    {
        if (
            millis() -
            buttonStartTime >=
            BUTTON_HOLD_TIME_MS
        )
        {
            buttonActive =
                currentButton;


            // ---------------------------------------------------------------
            // A = следующий диапазон.
            // ---------------------------------------------------------------

            if (
                currentButton ==
                BUTTON_A
            )
            {
                selectNextBand();
            }


            // ---------------------------------------------------------------
            // B = предыдущий диапазон.
            // ---------------------------------------------------------------

            else if (
                currentButton ==
                BUTTON_B
            )
            {
                selectPreviousBand();
            }
        }
    }
}


// ============================================================================
// ADC DISPLAY TASK
//
// Значение ADC обновляется независимо от обработки кнопок.
//
// Период:
//
//     100 мс
// ============================================================================

void adcDisplayTask()
{
    uint32_t now =
        millis();


    if (
        now -
        lastADCDisplayTime >=
        ADC_DISPLAY_PERIOD_MS
    )
    {
        lastADCDisplayTime =
            now;


        uint16_t adc =
            readADC();


        displayADC(
            adc
        );
    }
}


// ============================================================================
// SETUP
// ============================================================================

void setup()
{
    // ------------------------------------------------------------------------
    // Энкодер.
    // ------------------------------------------------------------------------

    encoderInit();


    // ------------------------------------------------------------------------
    // ADC3 / PC3 / физическая ножка 26.
    // ------------------------------------------------------------------------

    adcInit();


    // ------------------------------------------------------------------------
    // LCD.
    // ------------------------------------------------------------------------

    lcdInit();


    lcdSetCursor(
        0,
        0
    );

    lcdPrint(
        "Si5351 90deg"
    );


    lcdSetCursor(
        0,
        1
    );

    lcdPrint(
        "Starting..."
    );


    // ------------------------------------------------------------------------
    // Загружаем сохранённый диапазон и частоты.
    // ------------------------------------------------------------------------

    loadEEPROM();


    // ------------------------------------------------------------------------
    // Si5351 I2C.
    // ------------------------------------------------------------------------

    siI2CInit();


    _delay_ms(50);


    // ------------------------------------------------------------------------
    // Запускаем Si5351 на сохранённой частоте.
    //
    // Если EEPROM пустая, это будет:
    //
    //     40M / 7100 kHz
    // ------------------------------------------------------------------------

    if (
        !applyFrequency(
            currentFreqHz
        )
    )
    {
        lcdCommand(0x01);


        lcdSetCursor(
            0,
            0
        );

        lcdPrint(
            "SI5351 ERROR"
        );


        while (1)
        {
        }
    }


    // ------------------------------------------------------------------------
    // Начальное отображение.
    // ------------------------------------------------------------------------

    lcdCommand(0x01);


    displayFrequency();


    // ------------------------------------------------------------------------
    // Первое отображение ADC.
    // ------------------------------------------------------------------------

    displayADC(
        readADC()
    );


    lastADCDisplayTime =
        millis();
}


// ============================================================================
// LOOP
// ============================================================================

void loop()
{
    // ------------------------------------------------------------------------
    // Кнопки диапазонов.
    //
    // Нажатие должно быть >= 100 мс.
    // ------------------------------------------------------------------------

    buttonTask();


    // ------------------------------------------------------------------------
    // Энкодер.
    // ------------------------------------------------------------------------

    int8_t movement =
        readEncoder();


    if (movement != 0)
    {
        encoderAccumulator +=
            movement;


        // --------------------------------------------------------------------
        // Один полный шаг энкодера = 4 перехода.
        // --------------------------------------------------------------------

        if (
            encoderAccumulator >= 4
        )
        {
            encoderAccumulator =
                0;


            // ----------------------------------------------------------------
            // Увеличение на 1 kHz.
            // ----------------------------------------------------------------

            if (
                currentFreqHz +
                STEP_FREQ_HZ
                <=
                bands[currentBand].maxHz
            )
            {
                setCurrentFrequency(
                    currentFreqHz +
                    STEP_FREQ_HZ
                );
            }
        }


        else if (
            encoderAccumulator <= -4
        )
        {
            encoderAccumulator =
                0;


            // ----------------------------------------------------------------
            // Уменьшение на 1 kHz.
            // ----------------------------------------------------------------

            if (
                currentFreqHz >=
                bands[currentBand].minHz +
                STEP_FREQ_HZ
            )
            {
                setCurrentFrequency(
                    currentFreqHz -
                    STEP_FREQ_HZ
                );
            }
        }
    }


    // ------------------------------------------------------------------------
    // Обновление значения ADC на LCD каждые 100 мс.
    // ------------------------------------------------------------------------

    adcDisplayTask();
}
